/include/ "skeleton.dtsi"

/ {
	compatible = "nvidia,tegra148";
        interrupt-parent = <&intc>;


	timer@50004600 {
		compatible = "arm,cortex-a9-twd-timer";
		reg = <0x50040600 0x20>;
		interrupts = <1 13 0xf04>;
	};

        intc: interrupt-controller@50041000 {
                compatible = "arm,cortex-a9-gic";
                interrupt-controller;
                #interrupt-cells = <3>;
                reg = <0x50041000 0x1000>,
                      <0x50040100 0x0100>;
        };
};
